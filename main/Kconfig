## main/Kconfig
```kconfig
# Kconfig file for Wi-Fi Connections and LCD
menu "QuickReference Configuration"
    menu "Wi-Fi configuration"
        config WIFI_SSID
            string "Wi-Fi SSID"
        config WIFI_PASSWORD
            string "Wi-Fi Password"
    endmenu

    menu "LCD configuration"
        config LCD_CS_PIN
            int "LCD CS Pin"
            default 34
        config LCD_DC_PIN
            int "LCD DC Pin"
            default 37
        config LCD_SCLK_PIN
            int "LCD SCLK Pin"
            default 36
        config LCD_MOSI_PIN
            int "LCD MOSI Pin"
            default 35
        config LCD_MISO_PIN
            int "LCD MISO Pin"
            default -1
        config LCD_RST_PIN
            int "LCD RST Pin"
            default 38
        config LCD_H_RES 
            int "LCD Horizontal Resolution"
            default 128
        config LCD_V_RES
            int "LCD Vertical Resolution"
            default 160
        config LCD_COLOR_DEPTH
            int "LCD Color Depth"
            default 16
        config LCD_PIXEL_CLK_HZ
            int "LCD Pixel Clock Frequency"
            default 30000000
    endmenu

    menu "Weather API configuration"
        config WEATHER_API_URL
            string "Weather API URL"
            default "https://api.weather.gov/"
        config WEATHER_STATION_ID
            string "Weather Station ID"
            default "BHBM3"
        config WEATHER_REQUIRE_QC
            bool "Require Quality Control"
            default y
    endmenu
endmenu
    
```
